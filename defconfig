## defconfig
```kconfig
CONFIG_TARGET_ar71xx=y
CONFIG_TARGET_ar71xx_generic=y
#CONFIG_TARGET_brcm63xx=y
#CONFIG_TARGET_brcm63xx_Broadcom=y

# build all kmod packages
CONFIG_ALL_KMODS=y
# specify vermagic if necessary
CONFIG_KERNEL_VERMAGIC=""

# CONFIG_TARGET_ROOTFS_JFFS2 is not set

# ccache
CONFIG_DEVEL=y
CONFIG_CCACHE=y

# busybox
CONFIG_BUSYBOX_CONFIG_UNICODE_SUPPORT=y
CONFIG_BUSYBOX_CONFIG_LAST_SUPPORTED_WCHAR=0
CONFIG_BUSYBOX_CONFIG_UNICODE_COMBINING_WCHARS=y
CONFIG_BUSYBOX_CONFIG_UNICODE_WIDE_WCHARS=y
# remove the leading '#' to exclude the vi applet of busybox
## CONFIG_BUSYBOX_CONFIG_VI is not set

# build-in 3G modem support
CONFIG_PACKAGE_kmod-usb-serial=y
CONFIG_PACKAGE_kmod-usb-serial-option=y
CONFIG_PACKAGE_comgt=y
CONFIG_PACKAGE_usb-modeswitch=y
CONFIG_PACKAGE_usb-modeswitch-data=y
CONFIG_PACKAGE_vim-small=y

# build firewall as a package
CONFIG_PACKAGE_firewall=m

# core utils
CONFIG_PACKAGE_ip=m
CONFIG_PACKAGE_tc=m
CONFIG_PACKAGE_ip6tables=m
CONFIG_PACKAGE_ebtables=m
CONFIG_PACKAGE_ebtables-utils=m
CONFIG_PACKAGE_arptables=m
CONFIG_PACKAGE_iptables-mod-nat-extra=m

# VPN
CONFIG_PACKAGE_openvpn=m
CONFIG_PACKAGE_n2n=m
CONFIG_PACKAGE_ppp-mod-pptp=m
CONFIG_PACKAGE_pptpd=m

# storages
CONFIG_PACKAGE_block-mount=m
CONFIG_PACKAGE_autofs5=m
CONFIG_PACKAGE_autofs5-mount-ext2=m

# misc
CONFIG_PACKAGE_ez-ipupdate-3322=m
CONFIG_PACKAGE_openldap-server=m
CONFIG_PACKAGE_openldap-utils=m
CONFIG_PACKAGE_samba36-server=m
CONFIG_PACKAGE_samba36-client=m
CONFIG_PACKAGE_mwan3=m
CONFIG_PACKAGE_qos-scripts=m
CONFIG_PACKAGE_tcpdump=m
CONFIG_PACKAGE_wpa-cli=m
CONFIG_PACKAGE_iperf-mt=m
CONFIG_PACKAGE_netcat=m
CONFIG_PACKAGE_rsync=m
CONFIG_PACKAGE_git=m
CONFIG_PACKAGE_wol=m
CONFIG_PACKAGE_wget=m
CONFIG_PACKAGE_lftp=m
CONFIG_PACKAGE_sudo=m
CONFIG_PACKAGE_screen=m
CONFIG_PACKAGE_ntfs-3g=m
CONFIG_PACKAGE_NTFS-3G_USE_LIBFUSE=y

# luci and https
CONFIG_PACKAGE_luci=m
CONFIG_PACKAGE_luci-app-statistics=m
CONFIG_PACKAGE_luci-app-mwan3=m
CONFIG_PACKAGE_luci-app-ddns=m
CONFIG_PACKAGE_luci-proto-3g=m
CONFIG_PACKAGE_luci-ssl=m
CONFIG_PACKAGE_uhttpd-mod-tls=m
CONFIG_PACKAGE_uhttpd-mod-tls_cyassl=y

# zaptel fail to compile currently
# it is an external kmod, and has no impact on vermagic
# CONFIG_PACKAGE_kmod-zaptel14 is not set
# CONFIG_PACKAGE_kmod-zaptel14-dummy is not set
# CONFIG_PACKAGE_kmod-zaptel14-wctdm is not set
# CONFIG_PACKAGE_kmod-zaptel14-wcusb is not set
```
